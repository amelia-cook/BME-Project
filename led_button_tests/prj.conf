## CMakeLists.txt
```
cmake_minimum_required(VERSION 3.20.0)
find_package(Zephyr REQUIRED HINTS $ENV{ZEPHYR_BASE})

project(led_button_tests)

if(DEFINED TEST_BUILD AND TEST_BUILD)
    # Test build: Create a wrapper that includes main.c but renames main()
    # This avoids conflict with ztest's main()
    
    set(MAIN_C_PATH "${CMAKE_CURRENT_SOURCE_DIR}/src/main.c")
    
    file(WRITE ${CMAKE_CURRENT_BINARY_DIR}/main_student.c
"#define main student_main
#include \"${MAIN_C_PATH}\"
#undef main
")
    
    target_sources(app PRIVATE 
        ${CMAKE_CURRENT_BINARY_DIR}/main_student.c
        src/test_button_callback.c
    )
    
    message(STATUS "Building test suite (main() renamed to student_main)")
else()
    # Normal build
    target_sources(app PRIVATE src/main.c)
    message(STATUS "Building application")
endif()





# Basic Setup:

# Sets minimum CMake version to 3.20.0
# Finds and loads the Zephyr RTOS package
# Names the project "led_button_tests"

# Conditional Build Logic:
# The file uses an if statement to check whether TEST_BUILD is defined and set to true, then builds differently based on this:
# Test Build Mode (when TEST_BUILD is defined):

# Creates a clever workaround for a naming conflict: test frameworks like Zephyr's ztest have their own main() function, which would collide with your application's main()
# Generates a wrapper file (main_wrapper.c) on-the-fly that:

# Renames your original main() to student_main() using a preprocessor macro
# Includes your actual main.c file
# Undefines the macro afterward


# Adds both the wrapper and the test file (test_button_callback.c) to the build
# This allows the test framework's main() to run and call your renamed student_main() when needed

# Normal Build Mode (default):

# Simply includes your main.c file as-is
# No renaming tricks needed

# This is a common pattern in embedded testing where you want to run unit tests on your code without rewriting it, while avoiding the main() function conflict.
```

## prj.conf
```kconfig
CONFIG_LOG=y
CONFIG_LOG_MODE_DEFERRED=y
CONFIG_LOG_BUFFER_SIZE=4096

CONFIG_GPIO=y
CONFIG_EVENTS=y
```

## test.prj.conf
```kconfig
# Test-specific configuration file
# This file enables ztest and is used when building for testing

CONFIG_LOG=y
CONFIG_LOG_MODE_IMMEDIATE=y
CONFIG_LOG_MODE_DEFERRED=n
CONFIG_LOG_DEFAULT_LEVEL=4

CONFIG_GPIO=y
CONFIG_EVENTS=y

# Enable Zephyr Test Framework (ztest) for unit testing
CONFIG_ZTEST=y
CONFIG_ZTEST_STACK_SIZE=2048
CONFIG_MULTITHREADING=y

# When ztest is enabled, it provides its own main() function
# The student's main.c will be excluded from the test build
```

## boards/native_posix.overlay
```dts
/ {
  aliases {
    // add your aliases here; examples:
    buttontest = &button0;
    ledtest = &led0;  // this corresponds to LED1 on the board
  };

};
```

## src/main.c
```c
#include <zephyr/kernel.h>
// #include <zephyr/gpio.h>

// #include <zephyr/ztest.h>
#include <zephyr/sys/printk.h>
// #include <zephyr/drivers/adc.h>
#include <zephyr/drivers/gpio.h>

#include <zephyr/kernel.h>
#include <zephyr/device.h>
#include <zephyr/devicetree.h>
#include <zephyr/drivers/gpio.h> 
#include <zephyr/logging/log.h>
// #include <zephyr/drivers/adc/adc_emul.h>

LOG_MODULE_REGISTER(main, LOG_LEVEL_DBG);

#define LED_ON 1
#define LED_OFF 0
#define HEARTBEAT_TOGGLE_INTERVAL_MS 500

int err = 0;
int LED_STATE = LED_OFF;

K_EVENT_DEFINE(button_events);
#define BUTTON_EVENT BIT(0)

static const struct gpio_dt_spec led_test = GPIO_DT_SPEC_GET(DT_ALIAS(ledtest), gpios);
static const struct gpio_dt_spec button_test = GPIO_DT_SPEC_GET(DT_ALIAS(buttontest), gpios);

static struct gpio_callback button_test_cb;  

void button_test_callback(const struct device *dev, struct gpio_callback *cb, uint32_t pins);

static int init(){

    k_event_init(&button_events);

    if (!device_is_ready(button_test.port)) {
        LOG_ERR("gpio0 interface not ready.");  // logging module output
        return -1;  // exit code that will exit main()
    }

    err = gpio_pin_configure_dt(&button_test, GPIO_INPUT);
    if (err < 0) {
        LOG_ERR("Cannot configure sw0 pin.");
        return err;
    }

    err = gpio_pin_interrupt_configure_dt(&button_test, GPIO_INT_EDGE_TO_ACTIVE);
    if (err < 0) {
        LOG_ERR("Cannot attach callback to sw0.");
    }

    gpio_init_callback(&button_test_cb, button_test_callback, BIT(button_test.pin)); // populate CB struct with information about the CB function and pin
    gpio_add_callback_dt(&button_test, &button_test_cb);

    // configure GPIO pin
    err = gpio_pin_configure_dt(&led_test, GPIO_OUTPUT_ACTIVE);  // ACTIVE referes to ON, not HIGH
    if (err < 0) {
        LOG_ERR("Cannot configure GPIO output pin.");
        return err;
    }

    gpio_pin_set_dt(&led_test, LED_STATE);

    return 0;
}

int main(void)
{
    int err = init();

    if(err != 0){
        return -1;
    }

    uint32_t events = k_event_wait(&button_events, BUTTON_EVENT, true, K_FOREVER);

    if (events & BUTTON_EVENT) {
        LED_STATE = !LED_STATE;
        gpio_pin_set_dt(&led_test, LED_STATE);
        k_event_clear(&button_events, BUTTON_EVENT);
        if(LED_STATE == LED_OFF){
            LOG_INF("Button OFF pressed, LED OFF\n");
        } else {
            LOG_INF("Button ON pressed, LED ON\n");
        }
    }

    uint32_t event_2 = k_event_wait(&button_events, BUTTON_EVENT, true, K_FOREVER);

    if (event_2 & BUTTON_EVENT) {
        LED_STATE = !LED_STATE;
        gpio_pin_set_dt(&led_test, LED_STATE);
        k_event_clear(&button_events, BUTTON_EVENT);
        if(LED_STATE == LED_OFF){
            LOG_INF("Button OFF pressed, LED OFF\n");
        } else {
            LOG_INF("Button ON pressed, LED ON\n");
        }
    }
    
    k_msleep(100);

    LOG_INF("exiting code");
    return 0;
}


void button_test_callback(const struct device *dev, struct gpio_callback *cb, uint32_t pins)
{
    k_event_post(&button_events, BUTTON_EVENT);
}
```

## src/test_button_callback.c
```c
/**
 * @file test_button_callback_improved.c
 * @brief Enhanced unit tests for button callback functionality
 * 
 * This test file demonstrates comprehensive testing of button press functionality
 * by testing both the callback in isolation AND the full button press flow.
 * 
 * Testing Strategy:
 * 1. Test callback in isolation (what you currently have)
 * 2. Test that student_main() responds to simulated button presses
 * 3. Verify LED_STATE changes correctly
 * 4. Test edge cases (rapid presses, state verification)
 * 
 * Key Insight: We can run student_main() in a separate thread and simulate
 * button presses by calling the callback, then verify the results.
 */

#include <zephyr/ztest.h>
#include <zephyr/kernel.h>
#include <zephyr/drivers/gpio.h>
#include "test_button_callback.h"

/* Thread for running student's main code */
#define STUDENT_MAIN_STACK_SIZE 1024
#define STUDENT_MAIN_PRIORITY 5

K_THREAD_STACK_DEFINE(student_main_stack, STUDENT_MAIN_STACK_SIZE);
static struct k_thread student_main_thread;
static k_tid_t student_main_tid;

/* Flag to track if student_main is running */
static volatile bool main_is_running = false;

/* External reference to student's main (renamed by CMake) */
extern int student_main(void);

/**
 * @brief Wrapper to run student_main in a thread
 */
static void student_main_thread_entry(void *p1, void *p2, void *p3)
{
    ARG_UNUSED(p1);
    ARG_UNUSED(p2);
    ARG_UNUSED(p3);
    
    main_is_running = true;
    student_main();
    main_is_running = false;
}

/**
 * @brief Test fixture setup - runs before each test
 */
static void test_before(void *fixture)
{
    ARG_UNUSED(fixture);
    
    /* Initialize the event */
    k_event_init(&button_events);
    
    /* Clear any existing events */
    k_event_clear(&button_events, BUTTON_EVENT);
    
    /* Reset LED state */
    LED_STATE = LED_OFF;
    
    /* Ensure no student_main thread is running from previous test */
    if (main_is_running) {
        k_thread_abort(student_main_tid);
        k_msleep(50);  /* Give time for cleanup */
    }
}

/**
 * @brief Test fixture teardown - runs after each test
 */
static void test_after(void *fixture)
{
    ARG_UNUSED(fixture);
    
    /* Clean up student_main thread if still running */
    if (main_is_running) {
        k_thread_abort(student_main_tid);
        k_msleep(50);
    }
}

/******************************************************************************
 * PART 1: Test callback function in isolation
 * These tests verify the callback works correctly without running main()
 ******************************************************************************/

/**
 * @brief Test that callback posts BUTTON_EVENT when called
 * 
 * This is the fundamental test: does the callback do its job?
 */
ZTEST(button_press_tests, test_callback_posts_event)
{
    /* Verify event is clear initially */
    uint32_t events_before = k_event_wait(&button_events, BUTTON_EVENT, 
                                          false, K_NO_WAIT);
    zassert_equal(events_before, 0, 
                  "BUTTON_EVENT should not be set initially");
    
    /* Simulate button press by calling callback directly */
    button_test_callback(NULL, NULL, BIT(0));
    
    /* Small delay to ensure event is posted */
    k_msleep(5);
    
    /* Verify event was posted */
    uint32_t events_after = k_event_wait(&button_events, BUTTON_EVENT, 
                                         false, K_NO_WAIT);
    zassert_true(events_after & BUTTON_EVENT, 
                 "Callback should post BUTTON_EVENT");
    
    printk("✓ Callback correctly posts event\n");
}

/**
 * @brief Test callback can be called multiple times
 */
ZTEST(button_press_tests, test_callback_multiple_calls)
{
    /* First press */
    button_test_callback(NULL, NULL, BIT(0));
    k_msleep(5);
    
    uint32_t events1 = k_event_wait(&button_events, BUTTON_EVENT, 
                                    false, K_NO_WAIT);
    zassert_true(events1 & BUTTON_EVENT, 
                 "First callback should post event");
    
    /* Clear and press again */
    k_event_clear(&button_events, BUTTON_EVENT);
    button_test_callback(NULL, NULL, BIT(0));
    k_msleep(5);
    
    uint32_t events2 = k_event_wait(&button_events, BUTTON_EVENT, 
                                    false, K_NO_WAIT);
    zassert_true(events2 & BUTTON_EVENT, 
                 "Second callback should also post event");
    
    printk("✓ Callback handles multiple calls\n");
}

/**
 * @brief Test callback doesn't corrupt event flags
 * 
 * Verifies that calling the callback only sets BUTTON_EVENT,
 * not other potential event bits
 */
ZTEST(button_press_tests, test_callback_event_integrity)
{
    /* Clear all events */
    k_event_clear(&button_events, 0xFFFFFFFF);
    
    /* Call callback */
    button_test_callback(NULL, NULL, BIT(0));
    k_msleep(5);
    
    /* Check that ONLY BUTTON_EVENT is set */
    uint32_t all_events = k_event_wait(&button_events, 0xFFFFFFFF, 
                                       false, K_NO_WAIT);
    zassert_equal(all_events, BUTTON_EVENT, 
                  "Only BUTTON_EVENT should be set, got 0x%08x", all_events);
    
    printk("✓ Callback maintains event integrity\n");
}

/******************************************************************************
 * PART 2: Test full button press flow with student_main()
 * These tests run the student's main() and verify end-to-end behavior
 ******************************************************************************/

/**
 * @brief Test that student_main responds to first button press
 * 
 * This tests the complete flow:
 * 1. Start student_main (which waits for button press)
 * 2. Simulate button press via callback
 * 3. Verify LED_STATE toggles
 */
ZTEST(button_press_tests, test_main_responds_to_first_press)
{
    /* Start with LED OFF */
    LED_STATE = LED_OFF;
    int initial_state = LED_STATE;
    
    /* Start student_main in background thread */
    student_main_tid = k_thread_create(&student_main_thread,
                                       student_main_stack,
                                       K_THREAD_STACK_SIZEOF(student_main_stack),
                                       student_main_thread_entry,
                                       NULL, NULL, NULL,
                                       STUDENT_MAIN_PRIORITY, 0, K_NO_WAIT);
    
    /* Give main() time to reach k_event_wait() */
    k_msleep(50);
    
    /* Verify main is waiting (LED should not have changed yet) */
    zassert_equal(LED_STATE, initial_state,
                  "LED should not change before button press");
    
    /* Simulate button press */
    printk("Simulating button press...\n");
    button_test_callback(NULL, NULL, BIT(0));
    
    /* Give main() time to process the event */
    k_msleep(100);
    
    /* Verify LED_STATE toggled */
    zassert_not_equal(LED_STATE, initial_state,
                      "LED_STATE should toggle after button press (was %d, now %d)",
                      initial_state, LED_STATE);
    
    printk("✓ Main loop responds to first button press\n");
    printk("  Initial: %s, After press: %s\n",
           initial_state ? "ON" : "OFF",
           LED_STATE ? "ON" : "OFF");
}

/**
 * @brief Test that student_main responds to second button press
 * 
 * Tests the complete flow with two presses to ensure LED toggles correctly
 */
ZTEST(button_press_tests, test_main_responds_to_second_press)
{
    /* Start with LED OFF */
    LED_STATE = LED_OFF;
    
    /* Start student_main */
    student_main_tid = k_thread_create(&student_main_thread,
                                       student_main_stack,
                                       K_THREAD_STACK_SIZEOF(student_main_stack),
                                       student_main_thread_entry,
                                       NULL, NULL, NULL,
                                       STUDENT_MAIN_PRIORITY, 0, K_NO_WAIT);
    
    k_msleep(50);
    
    /* First press - should turn LED ON */
    printk("First button press...\n");
    button_test_callback(NULL, NULL, BIT(0));
    k_msleep(100);
    
    int state_after_first = LED_STATE;
    zassert_equal(state_after_first, LED_ON,
                  "LED should be ON after first press");
    
    /* Second press - should turn LED OFF */
    printk("Second button press...\n");
    button_test_callback(NULL, NULL, BIT(0));
    k_msleep(100);
    
    int state_after_second = LED_STATE;
    zassert_equal(state_after_second, LED_OFF,
                  "LED should be OFF after second press");
    
    printk("✓ Main loop correctly handles two button presses\n");
    printk("  OFF → ON → OFF\n");
}

/**
 * @brief Test LED state toggles correctly
 * 
 * Verifies the toggle pattern: OFF → ON → OFF
 */
ZTEST(button_press_tests, test_led_toggle_pattern)
{
    LED_STATE = LED_OFF;
    
    /* Start student_main */
    student_main_tid = k_thread_create(&student_main_thread,
                                       student_main_stack,
                                       K_THREAD_STACK_SIZEOF(student_main_stack),
                                       student_main_thread_entry,
                                       NULL, NULL, NULL,
                                       STUDENT_MAIN_PRIORITY, 0, K_NO_WAIT);
    
    k_msleep(50);
    
    /* Verify initial state */
    zassert_equal(LED_STATE, LED_OFF, "LED should start OFF");
    
    /* Press 1: OFF → ON */
    button_test_callback(NULL, NULL, BIT(0));
    k_msleep(100);
    zassert_equal(LED_STATE, LED_ON, "LED should be ON after first press");
    
    /* Press 2: ON → OFF */
    button_test_callback(NULL, NULL, BIT(0));
    k_msleep(100);
    zassert_equal(LED_STATE, LED_OFF, "LED should be OFF after second press");
    
    printk("✓ LED toggle pattern correct: OFF → ON → OFF\n");
}

/******************************************************************************
 * PART 3: Edge cases and timing tests
 ******************************************************************************/

/**
 * @brief Test rapid button presses
 * 
 * Verifies that events aren't lost when presses happen quickly
 */
ZTEST(button_press_tests, test_rapid_button_presses)
{
    LED_STATE = LED_OFF;
    
    /* Start student_main */
    student_main_tid = k_thread_create(&student_main_thread,
                                       student_main_stack,
                                       K_THREAD_STACK_SIZEOF(student_main_stack),
                                       student_main_thread_entry,
                                       NULL, NULL, NULL,
                                       STUDENT_MAIN_PRIORITY, 0, K_NO_WAIT);
    
    k_msleep(50);
    
    /* First rapid press */
    button_test_callback(NULL, NULL, BIT(0));
    k_msleep(10);  /* Very short delay */
    
    /* Verify state changed */
    int state_after_first = LED_STATE;
    zassert_not_equal(state_after_first, LED_OFF,
                      "LED should have changed after rapid first press");
    
    /* Second rapid press */
    button_test_callback(NULL, NULL, BIT(0));
    k_msleep(100);  /* Give more time for second press to process */
    
    /* Verify state changed back */
    zassert_not_equal(LED_STATE, state_after_first,
                      "LED should toggle even with rapid presses");
    
    printk("✓ System handles rapid button presses\n");
}

/**
 * @brief Test event clearing
 * 
 * Verifies that events are properly cleared between presses
 */
ZTEST(button_press_tests, test_event_clearing)
{
    /* Clear events */
    k_event_clear(&button_events, BUTTON_EVENT);
    
    /* Post event */
    button_test_callback(NULL, NULL, BIT(0));
    k_msleep(5);
    
    /* Verify event is set */
    uint32_t events = k_event_wait(&button_events, BUTTON_EVENT, 
                                   false, K_NO_WAIT);
    zassert_true(events & BUTTON_EVENT, "Event should be set");
    
    /* Clear it */
    k_event_clear(&button_events, BUTTON_EVENT);
    
    /* Verify it's cleared */
    events = k_event_wait(&button_events, BUTTON_EVENT, false, K_NO_WAIT);
    zassert_false(events & BUTTON_EVENT, "Event should be cleared");
    
    printk("✓ Events properly cleared between operations\n");
}

/* Register test suite */
ZTEST_SUITE(button_press_tests, NULL, NULL, test_before, test_after, NULL);
```

## src/test_button_callback.h
```c
/**
 * @file test_button_callback.h
 * @brief Header file exposing symbols from main.c for unit testing
 * 
 * This header allows the test file to access functions and variables
 * defined in main.c without modifying the student's code.
 * 
 * IMPORTANT: This file is for testing purposes only. Students should
 * not need to modify this file.
 */

#ifndef TEST_BUTTON_CALLBACK_H
#define TEST_BUTTON_CALLBACK_H

#include <zephyr/kernel.h>
#include <zephyr/drivers/gpio.h>

/* External declarations - these symbols are defined in main.c */
extern struct k_event button_events;
extern int LED_STATE;

/* LED state macros (from main.c) */
#define LED_ON 1
#define LED_OFF 0

/* Macro for button event bit */
#define BUTTON_EVENT BIT(0)

/* Function declaration - callback function from main.c */
extern void button_test_callback(const struct device *dev, 
                                 struct gpio_callback *cb, 
                                 uint32_t pins);

#endif /* TEST_BUTTON_CALLBACK_H */
```
