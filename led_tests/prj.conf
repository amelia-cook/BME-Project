## CMakeLists.txt
```
# cmake_minimum_required(VERSION 3.20.0)
# find_package(Zephyr REQUIRED HINTS $ENV{ZEPHYR_BASE})

# project(led_tests)

# target_sources(app PRIVATE src/main.c)

cmake_minimum_required(VERSION 3.20.0)

# --------------------------------------------------
# native_sim-only overlay generation
# --------------------------------------------------
if(DEFINED BOARD AND BOARD STREQUAL "native_sim")

  message(STATUS "native_sim build detected - generating devicetree overlay")

  find_package(Python3 REQUIRED COMPONENTS Interpreter)
  
  set(INPUT_OVERLAY ${CMAKE_CURRENT_SOURCE_DIR}/boards/native_posix.overlay)
  set(LED_DATA ${CMAKE_BINARY_DIR}/led_aliases.cmake)
  
  execute_process(
    COMMAND
      ${Python3_EXECUTABLE}
      ${CMAKE_CURRENT_SOURCE_DIR}/../scripts/extract_led_aliases.py
      ${INPUT_OVERLAY}
      ${LED_DATA}
    WORKING_DIRECTORY
      ${CMAKE_CURRENT_SOURCE_DIR}
    RESULT_VARIABLE OVERLAY_RESULT
  )
  
  if(NOT OVERLAY_RESULT EQUAL 0)
    message(FATAL_ERROR "Failed to generate native_sim overlay")
  endif()
  
  include(${LED_DATA})
  
  configure_file(
    ${CMAKE_CURRENT_SOURCE_DIR}/boards/native_sim.overlay.in
    ${CMAKE_CURRENT_SOURCE_DIR}/boards/native_sim.overlay
    @ONLY
  )
  
  
  
  
  

#   execute_process(
#     COMMAND
#       ${Python3_EXECUTABLE}
#       ${CMAKE_CURRENT_SOURCE_DIR}/../scripts/generate_overlay.py
#       ${CMAKE_CURRENT_SOURCE_DIR}/boards/native_posix.overlay
#     WORKING_DIRECTORY
#       ${CMAKE_CURRENT_SOURCE_DIR}
#     RESULT_VARIABLE OVERLAY_RESULT
#   )

#   if(NOT OVERLAY_RESULT EQUAL 0)
#     message(FATAL_ERROR "Failed to generate native_sim overlay")
#   endif()
  
  set(EXTRA_DTC_OVERLAY_FILE
      ${CMAKE_CURRENT_SOURCE_DIR}/boards/native_sim.overlay
  )

endif()

# --------------------------------------------------
# Standard Zephyr application setup
# --------------------------------------------------
find_package(Zephyr REQUIRED HINTS $ENV{ZEPHYR_BASE})
project(led_tests)

target_sources(app PRIVATE src/main.c)
```

## prj.conf
```kconfig
CONFIG_LOG=y
CONFIG_LOG_MODE_DEFERRED=y
CONFIG_LOG_BUFFER_SIZE=4096

CONFIG_GPIO=y
```

## boards/native_posix.overlay
```dts
/ {
  aliases {
    // add your aliases here; examples:
    ledtest = &led0;  // this corresponds to LED1 on the board
  };
};
```

## src/main.c
```c
#include <zephyr/kernel.h>
// #include <zephyr/gpio.h>

// #include <zephyr/ztest.h>
#include <zephyr/sys/printk.h>
// #include <zephyr/drivers/adc.h>
#include <zephyr/drivers/gpio.h>

#include <zephyr/kernel.h>
#include <zephyr/device.h>
#include <zephyr/devicetree.h>
#include <zephyr/drivers/gpio.h> 
#include <zephyr/logging/log.h>
// #include <zephyr/drivers/adc/adc_emul.h>

LOG_MODULE_REGISTER(main, LOG_LEVEL_DBG);

#define LED_ON 1
#define LED_OFF 0
#define HEARTBEAT_TOGGLE_INTERVAL_MS 500

static const struct gpio_dt_spec ledtest = GPIO_DT_SPEC_GET(DT_ALIAS(ledtest), gpios);
int err = 0;

static int init(){
    // check if interface is ready
    if (!device_is_ready(ledtest.port)) {
        LOG_ERR("gpio0 interface not ready.");  // logging module output
        return -1;  // exit code that will exit main()
    }

    // configure GPIO pin
    err = gpio_pin_configure_dt(&ledtest, GPIO_OUTPUT_ACTIVE);  // ACTIVE referes to ON, not HIGH
    if (err < 0) {
        LOG_ERR("Cannot configure GPIO output pin.");
        return err;
    }
    
    return 0;
}

static void run(){
    gpio_pin_set_dt(&ledtest, LED_ON);
    printk("LED ON\n");
    k_msleep(HEARTBEAT_TOGGLE_INTERVAL_MS);

    gpio_pin_set_dt(&ledtest, LED_OFF);
    printk("LED OFF\n");
    k_msleep(HEARTBEAT_TOGGLE_INTERVAL_MS);
}

int main(void)
{
    int err = init();

    if(err != 0){
        return -1;
    }

    for(int i = 0; i<5 ; i++){
        run();
    }

    return 0;
}
```
